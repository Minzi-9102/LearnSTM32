/*********************************************************************************************************
* 模块名称：Main.c
* 摘    要：主文件，包含软硬件初始化函数和main函数
* 当前版本：1.0.0
* 作    者：SZLY(COPYRIGHT 2018 - 2020 SZLY. All rights reserved.)
* 完成日期：2020年01月01日
* 内    容：
* 注    意：注意勾选Options for Target 'Target1'->Code Generation->Use MicroLIB，否则printf无法使用                                                                  
**********************************************************************************************************
* 取代版本：
* 作    者：
* 完成日期：
* 修改内容：
* 修改文件：
*********************************************************************************************************/

/*********************************************************************************************************
*                                              包含头文件
*********************************************************************************************************/
#include "Main.h"
#include "stm32f10x_conf.h"
#include "DataType.h"
#include "NVIC.h"
#include "SysTick.h"
#include "RCC.h"
#include "Timer.h"
#include "UART1.h"
#include "LED.h"
#include "RunClock.h"
#include <ctype.h>
#include <stdlib.h>

/*********************************************************************************************************
*                                              宏定义
*********************************************************************************************************/

/*********************************************************************************************************
*                                              内部变量
*********************************************************************************************************/

/*********************************************************************************************************
*                                              枚举结构体定义
*********************************************************************************************************/

/*********************************************************************************************************
*                                              内部函数声明
*********************************************************************************************************/
static  void  InitSoftware(void);   //初始化软件相关的模块
static  void  InitHardware(void);   //初始化硬件相关的模块
static  void  Proc2msTask(void);    //2ms处理任务
static  void  Proc1SecTask(void);   //1s处理任务
static 	const char *find_digit(const char *s);
static  int 	day_of_year(int m, int d);
static  int		extract_date(const char *text,int *y, int *m, int *d);
static  int 	date_str_to_day_of_year(const char *text);

/*********************************************************************************************************
*                                              内部函数实现
*********************************************************************************************************/
/*********************************************************************************************************
* 函数名称：find_digit
* 函数功能：从文本中找出连续数字，返回数字起始指针；找不到返回 NULL
* 输入参数：
* 输出参数：
* 返 回 值：
* 创建日期：2018年01月01日
* 注    意：
*********************************************************************************************************/
/* 从文本中找出连续数字，返回数字起始指针；找不到返回 NULL */
static const char *find_digit(const char *s)
{
    while (*s && !isdigit((unsigned char)*s))
        ++s;
    return (*s) ? s : NULL;
}
/*********************************************************************************************************
* 函数名称：day_of_year
* 函数功能：返回 2025 年 m 月 d 日是这一年的第几天
* 输入参数：int m, int d
* 输出参数：int
* 返 回 值：0，表示正确，-1，表示解析失败
* 创建日期：2018年01月01日
* 注    意：传入指针，函数直接修改指针指向地址的值
*********************************************************************************************************/

static int day_of_year(int m, int d)
{
    static const int days[13] = {0,31,28,31,30,31,30,31,31,30,31,30,31};   /* 平年 */
    int sum  = d;
		int i = 1;
    for (i = 1; i < m; ++i)
        sum += days[i];
    return sum;
}

/*********************************************************************************************************
* 函数名称：extract_date
* 函数功能：从形如 “2025年1月10日，星期五” 的字符串中提取年月日
* 输入参数：const char *text, int *m, int *d
* 输出参数：int
* 返 回 值：0，表示正确，-1，表示解析失败
* 创建日期：2018年01月01日
* 注    意：传入指针，函数直接修改指针指向地址的值
*********************************************************************************************************/
static int extract_date(const char *text,int *y, int *m, int *d)
{
		
		const char *p = text;
    int year = 0, mon = 0, day = 0;
		printf("在extract_date.\r\n" );  //打印系统状态
    /* 1) 跳过非数字，找到年份 */
    while (*p && !isdigit((unsigned char)*p)) ++p;
    if (!*p) return -1;
    while (isdigit((unsigned char)*p))
        year = year * 10 + (*p++ - '0');

    /* 2) 跳过汉字到月份 */
    while (*p && !isdigit((unsigned char)*p)) ++p;
    if (!*p) return -1;
    while (isdigit((unsigned char)*p))
        mon = mon * 10 + (*p++ - '0');

    /* 3) 跳过汉字到日期 */
    while (*p && !isdigit((unsigned char)*p)) ++p;
    if (!*p) return -1;
    while (isdigit((unsigned char)*p))
        day = day * 10 + (*p++ - '0');

    *y 	= year;
    *m  = mon;
    *d  = day;
    return 0;
}
/*********************************************************************************************************
* 函数名称：date_str_to_day_of_year
* 函数功能：用户接口：传入文字，返回第几天；失败返回
* 输入参数：const char *text, int *m, int *d
* 输出参数：int
* 返 回 值：0，表示正确，-1，表示解析失败
* 创建日期：2018年01月01日
* 注    意：传入指针，函数直接修改指针指向地址的值
*********************************************************************************************************/
int date_str_to_day_of_year(const char *text)
{
    int y,m, d;
		printf("Init System has been finished.\r\n" );  //打印系统状态
    if (extract_date(text, &y,&m, &d) != 0)
        return -1;
		printf("%d月%d日\n",m,d);
    return day_of_year( m, d);
}


/*********************************************************************************************************
* 函数名称：InitSoftware
* 函数功能：所有的软件相关的模块初始化函数都放在此函数中
* 输入参数：void
* 输出参数：void
* 返 回 值：void
* 创建日期：2018年01月01日
* 注    意：
*********************************************************************************************************/
static  void  InitSoftware(void)
{
	InitRunClock();
}

/*********************************************************************************************************
* 函数名称：InitHardware
* 函数功能：所有的硬件相关的模块初始化函数都放在此函数中
* 输入参数：void
* 输出参数：void
* 返 回 值：void
* 创建日期：2018年01月01日
* 注    意：
*********************************************************************************************************/
static  void  InitHardware(void)
{  
  SystemInit();       //系统初始化
  InitRCC();          //初始化RCC模块
  InitNVIC();         //初始化NVIC模块
  InitUART1(115200);  //初始化UART模块
  InitTimer();        //初始化Timer模块
  //InitLED();          //初始化LED模块
  InitSysTick();      //初始化SysTick模块
}

/*********************************************************************************************************
* 函数名称：Proc2msTask
* 函数功能：2ms处理任务 
* 输入参数：void
* 输出参数：void
* 返 回 值：void
* 创建日期：2018年01月01日
* 注    意：
*********************************************************************************************************/
static  void  Proc2msTask(void)
{  
  if(Get2msFlag())  //判断2ms标志状态
  { 
		RunClockPer2Ms();//每2ms运行一次该函数
    //LEDFlicker(250);//调用闪烁函数     
    Clr2msFlag();   //清除2ms标志
  }
}

/*********************************************************************************************************
* 函数名称：Proc1SecTask
* 函数功能：1s处理任务 
* 输入参数：void
* 输出参数：void
* 返 回 值：void
* 创建日期：2018年01月01日
* 注    意：
*********************************************************************************************************/
static  void  Proc1SecTask(void)
{ 
	
	i16 hour;
	i16 min;
	i16 sec;
	i16 day;
	
  if(Get1SecFlag()) //判断1s标志状态
  {
    //printf("This is the first STM32F103 Project, by Zhangsan\r\n");
//		hour = GetTimeVal(TIME_VAL_HOUR);
//		min = GetTimeVal(TIME_VAL_MIN);
//		sec = GetTimeVal(TIME_VAL_SEC);
//    DispTime(hour,min,sec);
		day = GetTimeVal();
		DispTime(day);
    Clr1SecFlag();  //清除1s标志
  }    
}

/*********************************************************************************************************
* 函数名称：main
* 函数功能：主函数 
* 输入参数：void
* 输出参数：void
* 返 回 值：int
* 创建日期：2018年01月01日
* 注    意：
*********************************************************************************************************/
int main(void)
{ 
	const char *str;
	int doy;
  InitSoftware();   //初始化软件相关函数
  InitHardware();   //初始化硬件相关函数
  
  printf("Init System has been finished.\r\n" );  //打印系统状态
	str = "2025年7月22日";
	doy = date_str_to_day_of_year(str);
	
	
	
	PauseClock(FALSE);
	
	SetTimeVal(doy);
//	SetTimeVal(TIME_VAL_MIN,59);
//	SetTimeVal(TIME_VAL_SEC,50);

  while(1)
  {
    Proc2msTask();  //2ms处理任务
    Proc1SecTask(); //1s处理任务   
  }
}
