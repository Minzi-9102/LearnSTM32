/*********************************************************************************************************
* 模块名称：Main.c
* 摘    要：主文件，包含软硬件初始化函数和main函数
* 当前版本：1.0.0
* 作    者：SZLY(COPYRIGHT 2018 - 2020 SZLY. All rights reserved.)
* 完成日期：2020年01月01日
* 内    容：
* 注    意：注意勾选Options for Target 'Target1'->Code Generation->Use MicroLIB，否则printf无法使用                                                                  
**********************************************************************************************************
* 取代版本：
* 作    者：
* 完成日期：
* 修改内容：
* 修改文件：
*********************************************************************************************************/

/*********************************************************************************************************
*                                              包含头文件
*********************************************************************************************************/
#include "Main.h"
#include "stm32f10x_conf.h"
#include "DataType.h"
#include "NVIC.h"
#include "SysTick.h"
#include "RCC.h"
#include "Timer.h"
#include "LED.h"
#include "UART1.h"
#include "KeyOne.h"
#include "ProcKeyOne.h"
#include "Calc.h"

/*********************************************************************************************************
*                                              宏定义
*********************************************************************************************************/
#define RX_BUF_LEN 64// 接收缓冲区长度
/*********************************************************************************************************
*                                              内部变量
*********************************************************************************************************/
u8 rxBuf[RX_BUF_LEN];// 接收缓冲区
u8 rxCnt = 0;// 接收计数
double result = 0.0; // 计算结果变量


/*********************************************************************************************************
*                                              枚举结构体定义
*********************************************************************************************************/

/*********************************************************************************************************
*                                              内部函数声明
*********************************************************************************************************/
static  void  InitSoftware(void);   //初始化软件相关的模块
static  void  InitHardware(void);   //初始化硬件相关的模块
static  void  Proc2msTask(void);    //2ms处理任务
static  void  Proc1SecTask(void);   //1s处理任务

/*********************************************************************************************************
*                                              内部函数实现
*********************************************************************************************************/
/*********************************************************************************************************
* 函数名称：InitSoftware
* 函数功能：所有的软件相关的模块初始化函数都放在此函数中
* 输入参数：void
* 输出参数：void
* 返 回 值：void
* 创建日期：2018年01月01日
* 注    意：
*********************************************************************************************************/
static  void  InitSoftware(void)
{
  rxBuf[RX_BUF_LEN-1] = '\0'; // 确保字符串结束
}

/*********************************************************************************************************
* 函数名称：InitHardware
* 函数功能：所有的硬件相关的模块初始化函数都放在此函数中
* 输入参数：void
* 输出参数：void
* 返 回 值：void
* 创建日期：2018年01月01日
* 注    意：
*********************************************************************************************************/
static  void  InitHardware(void)
{  
  SystemInit();       //系统初始化
  InitRCC();          //初始化RCC模块
  InitNVIC();         //初始化NVIC模块
  InitTimer();        //初始化Timer模块
  InitLED();          //初始化LED模块
  InitSysTick();      //初始化SysTick模块
	InitUART1(115200);
  InitKeyOne();       //初始化按键模块
  InitProcKeyOne();   //初始化按键处理模块
}

/*********************************************************************************************************
* 函数名称：Proc2msTask
* 函数功能：2ms处理任务 
* 输入参数：void
* 输出参数：void
* 返 回 值：void
* 创建日期：2018年01月01日
* 注    意：
*********************************************************************************************************/
static  void  Proc2msTask(void)
{  
	u8 recData;// 接收数据

	
  if(Get2msFlag())  //判断2ms标志状态
  { 
    ScanKeyOne(KEY_NAME_KEY1,ProcKeyUpKey1,ProcKeyDownKey1); //扫描KEY1按键
    ScanKeyOne(KEY_NAME_KEY2,ProcKeyUpKey2,ProcKeyDownKey2); //扫描KEY2按键
    ScanKeyOne(KEY_NAME_KEY3,ProcKeyUpKey3,ProcKeyDownKey3); //扫描KEY3按键
    LEDFlicker(250);//调用闪烁函数  
		while(ReadUART1(&recData,1))
		{
			//recData++;
      WriteUART1(&recData,1);
      // if (recData == '\r' || recData == '\n') // 如果是回车或换行，结束输入
      // {       
      //   //WriteUART1(&recData,1);
      //   rxBuf[rxCnt] = '\0'; // 结束字符串
      //   //WriteUART1(&rxBuf[rxCnt],1);
      //   rxCnt = 0; // 重置计数器
      //   // printf(rxBuf); // 打印接收到的字符串
      //   // result = calc(rxBuf);
      //   // printf("计算结果: %f\r\n", result);
      //   break;
      // }
      // else if (rxCnt < RX_BUF_LEN - 1) // 确保不溢出缓冲区
      // {
      rxBuf[rxCnt++] = recData; // 存储接收到的数据
      if (rxCnt >= RX_BUF_LEN) // 如果缓冲区满了，结束输入
      {
          rxBuf[RX_BUF_LEN - 1] = '\0'; // 确保字符串结束
          rxCnt = RX_BUF_LEN - 1; // 设置计数器到最大值
          printf("输入已满，停止接收。\r\n");
          break;
      }  
      // } 			
		}   
    Clr2msFlag();   //清除2ms标志
  }
}

/*********************************************************************************************************
* 函数名称：Proc1SecTask
* 函数功能：1s处理任务 
* 输入参数：void
* 输出参数：void
* 返 回 值：void
* 创建日期：2018年01月01日
* 注    意：
*********************************************************************************************************/
static  void  Proc1SecTask(void)
{ 
  if(Get1SecFlag()) //判断1s标志状态
  {
		
		//printf("真是绕了好大一圈路啊\r\n");
    Clr1SecFlag();     //清除1s标志
  }    
}

/*********************************************************************************************************
* 函数名称：CalcTask
* 函数功能：计算任务
* 输入参数：void
* 输出参数：void
* 返 回 值：void
* 创建日期：2018年01月01日
*********************************************************************************************************/
void CalcTask(void)
{
  u8 i;
  printf("%d\r\n", rxCnt);
  for ( i = 0; i < rxCnt; i++)
  {
    printf("%c", rxBuf[i]); // 打印接收到的字符
    /* code */
  }
  printf("\r\n");
  

   // 计算结果变量
  result = calc(rxBuf); // 调用计算函数
  // printf("计算结果: %f\r\n", result); // 打印计算结果
  // rxCnt = 0; // 重置计数器
}
void DisplayResult(void)
{
  printf("计算结果: %f\r\n", result); // 打印计算结果
}

void ClearRxBuf(void)
{
  u8 i;
  for (i = 0; i < rxCnt; i++)
  {
    rxBuf[i] = 0; // 清除接收缓冲区
  }
  rxBuf[0]   = '0';
  rxBuf[1]   = '+'; // 确保字符串结束
  rxBuf[2]   = '0';
  rxBuf[RX_BUF_LEN-1] = '\0';
  rxCnt = 0; // 清除接收缓冲区
  result = calc(rxBuf); // 调用计算函数
  printf("清空缓冲区: %f\r\n", result); 
}
/*********************************************************************************************************
* 函数名称：main
* 函数功能：主函数 
* 输入参数：void
* 输出参数：void
* 返 回 值：int
* 创建日期：2018年01月01日
* 注    意：
*********************************************************************************************************/
int main(void)
{ 
  double result; // 计算结果变量
  InitSoftware();   //初始化软件相关函数
  InitHardware();   //初始化硬件相关函数
  
  printf("Init System has been finished.\r\n" );  //打印系统状态
  //const u8 *expression = "3 + 5 * (2 - 8)"; // 测试表达式
  //double result = calc(expression); // 调用计算函数
  //printf("计算结果: %f\r\n", result);
  // rxBuf[0] = '9';
  // rxBuf[1] = '*';
  // rxBuf[2] = '1';
  // rxBuf[3] = ' ';
  // rxBuf[4] = '\0';
  // rxCnt = 5; // 初始化接收计数
  // result = calc(rxBuf); // 调用计算函数
  // printf("计算结果: %f\r\n", result); // 打印计算结果
  
   // 初始化接收缓冲区


  while(1)
  {
    Proc2msTask();  //2ms处理任务
    Proc1SecTask(); //1s处理任务   
  }
}
