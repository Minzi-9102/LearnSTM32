/*********************************************************************************************************
* 模块名称：ProcKeyOne.c
* 摘    要：ProcKeyOne模块，进行独立按键处理模块初始化，以及独立按键处理函数实现
* 当前版本：1.0.0
* 作    者：SZLY(COPYRIGHT 2018 - 2020 SZLY. All rights reserved.)
* 完成日期：2020年01月01日   
* 内    容：
* 注    意：                                                                  
**********************************************************************************************************
* 取代版本：
* 作    者：
* 完成日期：
* 修改内容：
* 修改文件：
*********************************************************************************************************/

/*********************************************************************************************************
*                                              包含头文件
*********************************************************************************************************/
#include "ProcKeyOne.h"
#include "UART1.h"
#include "DAC.h"
#include "Wave.h"
#include "OLED.h"
/*********************************************************************************************************
*                                              宏定义
*********************************************************************************************************/

/*********************************************************************************************************
*                                              枚举结构体定义
*********************************************************************************************************/

/*********************************************************************************************************
*                                              内部变量
*********************************************************************************************************/
	float ScaleUp = 1.0;
	float ScaleDown = 1.0;
	float ScaleIndex = 1.0;
	i8 WaveType = 0;
	u16* curWaveAddr = 0;
	u16 ScaledWave[100];
	StructDACWave WaveStruct;//DAC波形属性
	
/*********************************************************************************************************
*                                              内部函数声明
*********************************************************************************************************/
static u16* ScaleWaveToBuffer(u16* WaveAddr,u16* Buffer,float scale);//将指定类型的波形缩放后完整存入Buffer
/*********************************************************************************************************
*                                              内部函数实现
*********************************************************************************************************/
/*********************************************************************************************************
* 函数名称：ScaleWaveToBuffer
* 函数功能：
* 输入参数：
* 输出参数：
* 返 回 值：
* 创建日期：2018年01月01日
* 注    意：
*********************************************************************************************************/
static u16* ScaleWaveToBuffer(u16* WaveAddr,u16* Buffer,float scale)
{
	
	u16 WaveVal;
	u16 i;

	for(i = 0;i<100;i++)
	{
		WaveVal = (u16)((float)*(WaveAddr+i) * scale);
		if (WaveVal > 4095) WaveVal = 4095;
		Buffer[i] = WaveVal;
	}
		
	return Buffer;
}
/*********************************************************************************************************
*                                              API函数实现
*********************************************************************************************************/
/*********************************************************************************************************
* 函数名称：InitProcKeyOne(void)
* 函数功能：ProcKeyOne模块初始化函数
* 输入参数：void
* 输出参数：void
* 返 回 值：void
* 创建日期：2018年01月01日
* 注    意：
*********************************************************************************************************/
void InitProcKeyOne(void)
{
	curWaveAddr = GetSineWave100PointAddr();
	WaveStruct.waveBufAddr = (u32)curWaveAddr;
	WaveStruct.waveBufSize = 100;	
	OLEDShowString(32,16,"Sine!");
}

/*********************************************************************************************************
* 函数名称：ProcKeyUpKey1(void)
* 函数功能：按键松开事件处理函数
* 输入参数：void
* 输出参数：void
* 返 回 值：void
* 创建日期：2018年01月01日
* 注    意：
*********************************************************************************************************/
void ProcKeyUpKey1(void)
{
	printf("KEY1 RELEASE\r\n");

}
/*********************************************************************************************************
* 函数名称：ProcKeyDownKey1(void)
* 函数功能：按键松开事件处理函数
* 输入参数：void
* 输出参数：void
* 返 回 值：void
* 创建日期：2018年01月01日
* 注    意：
*********************************************************************************************************/
void ProcKeyDownKey1(void)
{

	switch(++WaveType)
	{
		case 0:
			printf("第一种波形");
			curWaveAddr = GetSineWave100PointAddr();
			WaveStruct.waveBufAddr = (u32)curWaveAddr;
			OLEDShowString(32,16,"Sine!");
			break;
		case 1:
			printf("第二种波形");
			curWaveAddr = GetTriWave100PointAddr();
			WaveStruct.waveBufAddr = (u32)curWaveAddr;
			OLEDShowString(32,16,"Tri!");
			break;
		case 2:
			printf("第三种波形");
			curWaveAddr = GetRectWave100PointAddr();
			WaveStruct.waveBufAddr = (u32)curWaveAddr;
			OLEDShowString(32,16,"Rect!");
			WaveType = -1;
			break;
		default:
			break;
	}
		ScaleIndex = 1.0;
		WaveStruct.waveBufSize = 100;
		SetDAC2Wave(WaveStruct);
	
	printf("KEY1 PUSH DOWN\r\n");
}
/*********************************************************************************************************
* 函数名称：ProcKeyUpKey2(void)
* 函数功能：按键松开事件处理函数
* 输入参数：void
* 输出参数：void
* 返 回 值：void
* 创建日期：2018年01月01日
* 注    意：
*********************************************************************************************************/
void ProcKeyUpKey2(void)
{
	printf("KEY2 RELEASE\r\n");

}
/*********************************************************************************************************
* 函数名称：ProcKeyDownKey2(void)
* 函数功能：按键松开事件处理函数
* 输入参数：void
* 输出参数：void
* 返 回 值：void
* 创建日期：2018年01月01日
* 注    意：
*********************************************************************************************************/
void ProcKeyDownKey2(void)
{	
	ScaleIndex = ScaleIndex+0.1;
	WaveStruct.waveBufAddr = (u32)ScaleWaveToBuffer(curWaveAddr,ScaledWave,ScaleIndex);
	SetDAC2Wave(WaveStruct);
	printf("KEY2 PUSH DOWN\r\n");
}
/*********************************************************************************************************
* 函数名称：ProcKeyUpKey3(void)
* 函数功能：按键松开事件处理函数
* 输入参数：void
* 输出参数：void
* 返 回 值：void
* 创建日期：2018年01月01日
* 注    意：
*********************************************************************************************************/
void ProcKeyUpKey3(void)
{
	printf("KEY3 RELEASE\r\n");

}
/*********************************************************************************************************
* 函数名称：ProcKeyDownKey3(void)
* 函数功能：按键松开事件处理函数
* 输入参数：void
* 输出参数：void
* 返 回 值：void
* 创建日期：2018年01月01日
* 注    意：
*********************************************************************************************************/
void ProcKeyDownKey3(void)
{
	ScaleIndex = ScaleIndex-0.1;
	WaveStruct.waveBufAddr = (u32)ScaleWaveToBuffer(curWaveAddr,ScaledWave,ScaleIndex);
	SetDAC2Wave(WaveStruct);
	printf("KEY3 PUSH DOWN\r\n");
}
